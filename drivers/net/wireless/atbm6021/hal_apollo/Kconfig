## drivers/net/wireless/atbm6021/hal_apollo/Kconfig
```kconfig
config ATBM_APOLLO
       tristate "ATBM_APOLLO WLAN support"
       select ATBM_MAC80211
       help

         This is an experimental driver for the ATBM_APOLLO chip-set.
         Enabling this option enables the generic driver without
         any platform support.

         Please select the appropriate platform below.

if ATBM_APOLLO
choice
      prompt "select which chip type will be used,default is athenaB"
      default ATBM_ATHENALITE_CHIP
      depends on ATBM_APOLLO
      help
        Here,you must make sure what wireless chip you will want to use,athenaA
	athenaB,athenaC,athenaLite,ares
config ATBM_ATHENAA_CHIP
      bool "athenaA chip"
      depends on ATBM_APOLLO
      help
        we will use athenaA chip
config ATBM_ATHENAB_CHIP
      bool "athenaB chip"
      depends on ATBM_APOLLO
      help
	we will use athenaB chip

config ATBM_ATHENAC_CHIP
      bool "athenaC chip"
      depends on ATBM_APOLLO
      help
	we will use athenaC chip

config ATBM_ATHENALITE_CHIP
      bool "athenaLite chip"
      depends on ATBM_APOLLO
      help
        we will use athenaLite chip

config ATBM_ARES_CHIP
      bool "ares chip"
      depends on ATBM_APOLLO
      help
        we will use ares chip

endchoice

choice
      prompt "select which bus will be used"
      default ATBM_USB_BUS
      depends on ATBM_APOLLO
      help
        Here,you must make sure what interface you will want to use,usb
        sdio or spi
config ATBM_USB_BUS
      bool "usb bus"
      depends on ATBM_APOLLO
      help
        we will use usb bus
config ATBM_SDIO_BUS
      bool "sdio bus"
      depends on ATBM_APOLLO
      help

config ATBM_SPI_BUS
      bool "spi bus"
      depends on ATBM_APOLLO
      help
        we will use spi bus
endchoice

config ATBM_APOLLO_USE_GPIO_IRQ
      bool "Use GPIO interrupt"
      depends on ATBM_APOLLO && ATBM_SDIO_BUS
      default n
      help
        Say Y here if you want to include GPIO IRQ support instead of SDIO IRQ.
        If unsure, say N.

config ATBM_APOLLO_WAPI_SUPPORT
      bool "WAPI support"
      depends on ATBM_APOLLO
      default n
      help
        Say Y if your compat-wireless support WAPI.
        If unsure, say N.



config ATBM_APOLLO_SUPPORT_SGI
      bool "Use short GI support"
      depends on ATBM_APOLLO
      default y
      help
        Say Y here if you want to include short gi support
        If unsure, say N.


menu "Driver debug features"
      depends on ATBM_APOLLO

config ATBM_APOLLO_DEBUGFS
      bool "Expose driver internals to DebugFS (DEVELOPMENT)"

config ATBM_APOLLO_DEBUG_ON_BOOT
      bool "Enable selected driver debug messages during boot time (DEVELOPMENT)"

config ATBM_APOLLO_BH_DEBUG
      bool "Enable low-level device communication logs (DEVELOPMENT)"

config ATBM_APOLLO_WSM_DEBUG
      bool "Enable WSM API debug messages (DEVELOPMENT)"

config ATBM_APOLLO_WSM_DUMPS
      bool "Verbose WSM API logging (DEVELOPMENT)"

config ATBM_APOLLO_WSM_DUMPS_SHORT
      bool "Dump only first x bytes (default 20) (DEVELOPMENT)"

config ATBM_APOLLO_TXRX_DEBUG
      bool "Enable TX/RX debug messages (DEVELOPMENT)"

config ATBM_APOLLO_TX_POLICY_DEBUG
      bool "Enable TX policy debug (DEVELOPMENT)"

config ATBM_APOLLO_STA_DEBUG
      bool "Enable STA/AP debug (DEVELOPMENT)"

config ATBM_APOLLO_DUMP_ON_ERROR
      bool "Dump kernel in case of critical error (DEVELOPMENT)"

endmenu
source "drivers/net/wireless/atbm6021/hal_apollo/mac80211/Kconfig"
endif
```

## drivers/net/wireless/xr829/Kconfig
```kconfig
menuconfig XR_829
	tristate "XRadio WLAN support(xr829)"
	default n
	select CFG80211
	select AVERAGE
	select CRYPTO
	select CRYPTO_ARC4
	---help---
	  To compile this code as a module, choose M here.

if XR_829

menuconfig XRMAC
	tristate "XRadio MAC features"
	default m
	---help---
	  To compile this code as a module, choose M here.

if XRMAC

config XRMAC_RC_DEFAULT
	string "XRMAC_RC_DEFAULT"
	default "minstrel_ht"
	---help---

config XRMAC_RC_PID
	bool "XRMAC_RC_PID"
	depends on XRMAC
	default n
	---help---

config XRMAC_RC_MINSTREL
	bool "XRMAC_RC_MINSTREL"
	depends on XRMAC
	default y
	---help---

config XRMAC_RC_MINSTREL_HT
	bool "Minstrel 802.11n support" if EXPERT
	depends on XRMAC_RC_MINSTREL
	default y
	---help---
	  This option enables the 'minstrel_ht' TX rate control algorithm

config XRMAC_DEBUGFS
	bool "XRMAC_DEBUGFS"
	depends on XRMAC
	default y
	---help---
	  This option enables the debugfs of 'minstrel'(TX rate control algorithm)

endif #XRMAC

menuconfig XRADIO
	tristate "XRadio Driver features"
	default m
	---help---
	  This is an experimental driver for the XRADIO chip-set.
	  Enabling this option enables the generic driver without
	  any platform support.
	  Please select the appropriate platform below.

if XRADIO

config XRADIO_SDIO
	bool "SDIO bus wlan module"
	depends on XRADIO
	select MMC_UNSAFE_RESUME
	default y
	---help---
	  Say N here if module don't use sdio bus.
	  If unsure, say Y.

config XRADIO_NON_POWER_OF_TWO_BLOCKSIZES
	bool "Platform supports non-power-of-two SDIO transfer"
	depends on XRADIO
	default y
	---help---
	  Say N here only if you are running the driver on a platform
	  which does not have support for non-power-of-two SDIO transfer.
	  If unsure, say Y.

config XRADIO_USE_GPIO_IRQ
	bool "Use GPIO interrupt"
	depends on XRADIO
	default y
	---help---
	  Say Y here if you want to include GPIO IRQ support instead of SDIO IRQ.
	  If unsure, say Y.

config XRADIO_SUSPEND_POWER_OFF
	bool "Wlan power off in suspend"
	depends on XRADIO && PM
	default n
	---help---
	  Say Y if you want to wlan power off in suspend,
	  and then WoW will be disable.
	  If unsure, say N.

config XRADIO_EXTEND_SUSPEND
	bool "Support extend suspend(both Wow and power off)"
	depends on XRADIO && PM
	select XRADIO_SUSPEND_POWER_OFF
	default n
	---help---
	  Say Y if you want to support extend supend, but
	  extend suspend need to be support on your platform.
	  If unsure, say N.

config XRADIO_NOMAL_SUSPEND_FORCE
	bool "Support normal suspend(Wow for Single Crystal)"
	depends on XRADIO && PM && !XRADIO_SUSPEND_POWER_OFF
	default n
	---help---
	  Say Y if you want to support Wow for the special platform,
	  on which reference Clock of wlan input from host CPU,
	  but need to check it is support on your platform.
	  If unsure, say N.

menu "Driver debug features"
	depends on XRADIO

config XRADIO_DEBUG
	bool "Enable XRADIO debug messages (DEVELOPMENT)"
	default y
	---help---
	  Say Y if want driver debug information.
	  If unsure, say Y.

config XRADIO_ETF
	bool "XRADIO ETF Support for RF Test(DEVELOPMENT)"
	depends on XRADIO_DEBUG
	default y
	---help---
	  Say Y if want driver support ETF mode.
	  If unsure, say Y.

config XRADIO_DUMP_ON_ERROR
	bool "Dump kernel in case of critical error (DEVELOPMENT)"
	depends on XRADIO_DEBUG
	default n
	---help---
	  Say Y if want to Dump kernel in case of critical error.
	  If unsure, say N.

config XRADIO_DEBUGFS
	bool "Expose driver internals to DebugFS (DEVELOPMENT)"
	depends on XRADIO_DEBUG
	default y
	---help---
	  Say Y if want more methods to debug.
	  If unsure, say Y.

endmenu

endif #XRADIO

endif #XR_829
```
